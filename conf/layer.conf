## conf/layer.conf
```bitbake
# SPDX-FileCopyrightText: 2020-2023 Gelioson <gelioson@gmail.com>
#
# SPDX-License-Identifier: MIT

# We have a conf and classes directory, add to BBPATH
BBPATH .= ":${LAYERDIR}"

# We have recipes-* directories, add to BBFILES
BBFILES += "${LAYERDIR}/recipes-*/*/*.bb \
            ${LAYERDIR}/recipes-*/*/*.bbappend"

BBFILE_COLLECTIONS += "meta-zerotier"
BBFILE_PATTERN_meta-zerotier = "^${LAYERDIR}/"
BBFILE_PRIORITY_meta-zerotier = "5"

LAYERDEPENDS_meta-zerotier = "core openembedded-layer clang-layer"
LAYERSERIES_COMPAT_meta-zerotier = "kirkstone"
```
